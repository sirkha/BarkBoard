/dts-v1/;
/plugin/;

/ {
    compatible = "ti,beaglebone", "ti,beaglebone-black";
    
    /* identification */
    part-number = "BarkBoard";
    
    /* version */
    version = "00A0";
    
    exclusive-use = 
        "",
        "";
    
    fragment@0 {
        target = <&am33xx_pinmux>;
        __overlay__ {
            : {
                , = <
                
                >;
            };
        };
    };
};
